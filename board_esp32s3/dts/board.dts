// SPDX-License-Identifier: Apache-2.0
/*
 * ESP32-S3-DevKitC-1 板级设备树 — 承载从 STM32F407 移植过来的应用:
 *   led / button1 / button2   → app_led, app_button
 *   communicate               → app_uart_recv (+ app_uart_cmd 命令层)
 *   st7789 (display)          → app/ui 的 LVGL 显示端口
 *
 * 引脚按 DevKitC-1 空闲脚挑选 (与 rust/esp32/s3/example 的板级约定一致),
 * 与实际接线不符时只改本文件 + app_button.cpp 里的有效电平。
 *
 * console 日志走 ESP-IDF 自带控制台, 不占设备 label, 故没有 console 节点。
 * OTA 口未移植 (mini-ota 仅支持 Cortex-M), 故没有 ota 节点。
 */
/dts-v1/;

#include "esp32s3-soc.dtsi"
#include "esp32s3-gpios.dtsi"
#include "esp32s3-uart.dtsi"
#include "esp32s3-spi.dtsi"
#include "esp32s3-tim.dtsi"
#include "esp32s3-st7789.dtsi"

/chosen {
	tick-rate = <1000>;
	heap-size = <32768>;
};

/ {
	#address-cells = <1>;
	#size-cells = <0>;

	model = "Espressif ESP32-S3-DevKitC-1";
	compatible = "espressif,esp32-s3-devkitc-1", "espressif,esp32s3";
};

/* -------------------------------------------------------------------------- */
/* 外设使能收口: dtsi 只给 disabled 模板, 开关与引脚覆盖统一在本文件             */
/* -------------------------------------------------------------------------- */

/* 板载 LED: GPIO2, 高电平灭 (接低电平亮的 LED 时把 default-level 改 0) */
&led {
	gpio-pin = <2>;
	status = "okay";
};

/* 按键1: GPIO0  (DevKitC-1 的 BOOT 键, 按下为低)
 * 按键2: GPIO47 (空闲脚, 按下为低)
 * @note 引脚与有效电平要和 app_button.cpp 的实例配置一致 */
&button1 {
	gpio-pin = <0>;
	status = "okay";
};

&button2 {
	gpio-pin = <47>;
	status = "okay";
};

/* 业务通信口: UART1 (GPIO17=TX / GPIO18=RX, 115200) — communicate 任务收发 */
&communicate_uart {
	status = "okay";
};

&communicate {
	status = "okay";
};

/* 显示: SPI2_HOST + ST7789 (DC/RST 走 GPIO, 背光走 LEDC) */
&display {
	status = "okay";
};

&display_spi_client {
	status = "okay";
};

&lcd_dc {
	status = "okay";
};

&lcd_rst {
	status = "okay";
};

&tim_bl {
	status = "okay";
};

&st7789 {
	status = "okay";
};

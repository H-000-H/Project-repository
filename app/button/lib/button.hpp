/**
 * @file button.hpp
 * @author H-000-H
 * @brief Generic C++ button library
 * @details Default debounce is set; if you use RC hardware debounce, set debounce to 0 to disable it.
 *
 *      - Callback mode (compile-time auto-switch, two mutually exclusive API sets):
 *      - With mini_tree: board-level DTS declares compatible="mini,button" → dtc-lite generates
 *      - DTC_GEN_COUNT_MINI_BUTTON → auto-enables ETL callback (etl::delegate, type-safe)
 *      - Without mini_tree: manually define CONFIG_BUTTON_USE_ETL to enable ETL callback
 *      - Neither of the above: falls back to plain void* callback, no third-party dependency,
 *      - maximum portability
 * @copyright SPDX-License-Identifier: Apache-2.0
 */
#ifndef BUTTON_HPP
#define BUTTON_HPP
#include "schedule.h"
#include <cstdint>
#include <errno.h>
#include "mini_backend.h"
#if defined(__has_include)
#if __has_include(<etl/delegate.h>)
#    define BUTTON_HAVE_ETL_DELEGATE 1
#  endif
#endif

/* DTC macro fallback: when not integrated with mini_tree, DTC_GEN_COUNT_MINI_BUTTON
 * is not generated by dtc-lite; default to 0 here. */
#ifndef DTC_GEN_COUNT_MINI_BUTTON
#  define DTC_GEN_COUNT_MINI_BUTTON 0
#endif

/* ETL available && (integrated with mini_tree || manually enabled) → enable ETL callback */
#if defined(BUTTON_HAVE_ETL_DELEGATE) && ((DTC_GEN_COUNT_MINI_BUTTON > 0) || defined(CONFIG_BUTTON_USE_ETL))
#  define BUTTON_FEATURE_ETL 1
#  include <etl/delegate.h>
#endif

namespace button
{
/* ------------------------------------------------------------------------------------------------------------------------------------------------ */
/* ------------------------------------------------------------------------------------------------------------------------------------------------ */
    inline uint32_t bit = 0; // Button ID allocation bitmap (1<<(id-1) maps to one button)

    // Count trailing zeros (find position of lowest set bit)
    static inline __attribute__((always_inline)) uint8_t ctz(uint32_t x)
    {
        return static_cast<uint8_t>(__builtin_ctz(x));
    }

/* ------------------------------------------------------------------------------------------------------------------------------------------------ */
/* ------------------------------------------------------------------------------------------------------------------------------------------------ */
    constexpr uint8_t  kScan_Freq_Ms               = 50;   // Scan period (ms)
    constexpr uint16_t kMultiple_Click_Interval_Ms = 500;  // Multi-click judgment interval (ms)
    constexpr uint8_t  kDebounce_Ms                = 12;   // Default debounce duration (ms)
    constexpr uint16_t kShort_Trigger_Ms           = 50;   // Default short press trigger time (ms)
    constexpr uint16_t kLong_Trigger_Ms            = 1000; // Default long press trigger time (ms)
    constexpr uint16_t kLong_Hold_Trigger_Ms       = 3000; // Default long hold trigger time (ms)
    constexpr uint8_t  kRepeat_Click_Threshold     = 3;    // Repeat click threshold (>=3 counts as repeat)
    constexpr uint8_t  kNot_Pressed                = 0;    // Not pressed level value
    constexpr uint8_t  kPressed                    = 1;    // Pressed level value
    constexpr uint8_t  kBit_Num                    = 32;   // Total bitmap bits (max button count)

/* ------------------------------------------------------------------------------------------------------------------------------------------------ */
/* ------------------------------------------------------------------------------------------------------------------------------------------------ */
    // Button event type
    enum class Button_Event
    {
        kPressed_Down           = 1, // Press down (each press edge, including re-press during multi-click)
        kSignal_Pressed_Click      , // Single click completed
        kDouble_Pressed_Click      , // Double click completed
        kPressed_Repeat_Click      , // Repeat click
        kPressed_Short_Start       , // Short press start (triggered once)
        kPressed_Short_Over        , // Short press end
        kPressed_Long_Start        , // Long press start
        kPressed_Long_Over         , // Long press end (triggered once)
        kPressed_Long_Hold         , // Long press hold
        kPressed_Long_Hold_Over    , // Long press hold end
        kPressed_None              , // No event
        kPressed_Event_Num         , // Number of button events
    };

    // Button state machine states
    enum class Button_Status
    {
        kPressed        = 0, // Pressed state
        kMultiple_Click    , // Multi-click state
        kNone              , // Not pressed (default state)
    };

/* ------------------------------------------------------------------------------------------------------------------------------------------------ */
/* ------------------------------------------------------------------------------------------------------------------------------------------------ */
    // Check whether a given id is already allocated
    static inline bool bit_is_used(uint8_t id)
    {
        return (bit >> (id - 1U)) & 1U;
    }

    // Check whether the bitmap is full (all bits allocated)
    static inline bool bit_is_full()
    {
        return ~bit == 0U;
    }

    // Check whether any button has been created
    static inline bool bit_has_any()
    {
        return bit != 0U;
    }

    // Clear the bitmap (reset all id allocation status)
    static inline void bit_clear()
    {
        bit = 0U;
    }

    // Allocate a free id; returns 0 if bitmap is full
    static inline uint8_t bit_alloc()
    {
        if(bit_is_full())
            return 0U; /* Full, allocation failed */
        return static_cast<uint8_t>(ctz(~bit) + 1U);
    }

    // Release a given id
    static inline void bit_free(uint8_t id)
    {
        bit &= ~(1U << (id - 1U));
    }

    // Get the next allocated id (for iteration); returns 0 if none
    static inline uint8_t bit_next(uint8_t from)
    {
        uint32_t mask = bit >> (from - 1U); /* Skip bits before 'from' */
        if(mask == 0U)
            return 0U;
        return static_cast<uint8_t>(ctz(mask) + from);
    }

/* ------------------------------------------------------------------------------------------------------------------------------------------------ */
/* ------------------------------------------------------------------------------------------------------------------------------------------------ */
    // Return system millisecond tick for debounce; must be provided by the user
    inline int get_tick();

/* ------------------------------------------------------------------------------------------------------------------------------------------------ */
/* ------------------------------------------------------------------------------------------------------------------------------------------------ */
    /**
     * @brief Button class: manages state machine and event callback for a single button
     *
     * Non-template design: all buttons hang on the same linked list;
     * Button::scan() drives them all in one pass.
     * Callback type is determined by compile-time feature flags
     * (ETL delegate or void* function pointer).
     */
    class Button
    {
    public:
/* ------------------------------------------------------------------------------------------------------------------------------------------------ */
/* ------------------------------------------------------------------------------------------------------------------------------------------------ */
        // Constructor: allocates id and appends to linked list
        Button()
        {
            id = bit_alloc(); /* Returns 0 when full; not appended */
            if(id != 0U)
                list_append(this);
        }

        // Destructor: releases id and removes from linked list
        ~Button()
        {
            if(id != 0U)
                bit_free(id);
            list_remove(this);
        }

/* ------------------------------------------------------------------------------------------------------------------------------------------------ */
/* ------------------------------------------------------------------------------------------------------------------------------------------------ */
#ifdef BUTTON_FEATURE_ETL
        /**
         * @brief Callback type: ETL delegate; registration is the same as plain C function pointer
         * @code
         * // Option 1: plain function (no extra state needed)
         * btn.callback_register(Button_Callback::create<my_on_event>());
         * // Option 2: lvalue lambda capturing user data (when state is needed)
         * auto on_evt = [&data](button::Button& self) -> bool { ... };
         * btn.callback_register(on_evt);
         * @endcode
         */
        using Button_Callback = etl::delegate<bool(Button& self)>;
#else
        // Callback type: function pointer + user data pointer (may be null); cast back inside callback
        using Button_Callback = bool (*)(void* user, Button& self);
#endif

/* ------------------------------------------------------------------------------------------------------------------------------------------------ */
/* ------------------------------------------------------------------------------------------------------------------------------------------------ */
        uint16_t max_multiple_clicks_interval_ms = kMultiple_Click_Interval_Ms; // Multi-click judgment interval (ms)
        uint16_t debounce_ms                     = kDebounce_Ms;                // Debounce duration (ms)
        uint32_t press_debounce_start_tick       = 0;                           // Press debounce timing start (tick)
        uint32_t release_debounce_start_tick     = 0;                           // Release debounce timing start (tick)
        uint16_t short_press_trigger_ms          = kShort_Trigger_Ms;           // Short press trigger time (ms)
        uint16_t long_press_trigger_ms           = kLong_Trigger_Ms;            // Long press trigger time (ms)
        uint16_t long_hold_trigger_ms            = kLong_Hold_Trigger_Ms;       // Long hold trigger time (ms)

/* ------------------------------------------------------------------------------------------------------------------------------------------------ */
/* ------------------------------------------------------------------------------------------------------------------------------------------------ */
#ifdef BUTTON_FEATURE_ETL
        /**
         * @brief External callback registration entry (ETL version)
         * @param Callback delegate callback (function pointer or lvalue lambda; see Button_Callback for usage)
         * @return whether registration succeeded
         */
        bool callback_register(Button_Callback Callback)
        {
            event_cb = Callback;
            return true;
        }
#else
        /**
         * @brief External callback registration entry (void* version)
         * @param Callback callback function
         * @param user user data pointer (type defined by caller, may be null)
         * @return whether registration succeeded
         */
        bool callback_register(Button_Callback Callback, void* user = nullptr)
        {
            event_cb = Callback;
            user_data = user;
            return true;
        }
#endif

/* ------------------------------------------------------------------------------------------------------------------------------------------------ */
/* ------------------------------------------------------------------------------------------------------------------------------------------------ */
        /**
         * @brief Read current event
         * @return current event value
         */
        Button_Event event_read()
        {
            return event;
        }

        /**
         * @brief Read button id
         * @return id value
         */
        uint8_t read_id()
        {
            return id;
        }

        /**
         * @brief Read current state machine state
         * @return current state
         */
        Button_Status read_status()
        {
            return status;
        }

        /**
         * @brief Read whether currently pressed
         * @return pressed_value (0 = not pressed / 1 = pressed)
         */
        uint8_t read_pressed()
        {
            return pressed_value;
        }

        /**
         * @brief Set current button level (called once per scan cycle from GPIO read)
         * @param level current level value (0 = not pressed / non-zero = pressed)
         */
        void set_preesed(uint8_t level)
        {
            pressed_value = (level != kNot_Pressed) ? kPressed : kNot_Pressed;
        }

/* ------------------------------------------------------------------------------------------------------------------------------------------------ */
/* ------------------------------------------------------------------------------------------------------------------------------------------------ */
        /**
         * @brief Advance the state machine by one step
         * @return always true
         */
        bool update()
        {
            /* Non-default state: accumulate one scan period's ms each cycle; cap to prevent uint32 overflow re-triggering short/long press */
            if(status != Button_Status::kNone)
            {
                scan_cnt += kScan_Freq_Ms;
                /* Cap at max of long-hold and multi-click settlement; multi-click uses strict greater-than, so add one extra scan period margin */
                uint32_t cap = long_hold_trigger_ms;
                uint32_t multiple_click_cap = static_cast<uint32_t>(max_multiple_clicks_interval_ms) + kScan_Freq_Ms;
                if(multiple_click_cap > cap)
                    cap = multiple_click_cap;
                if(scan_cnt > cap)
                    scan_cnt = cap;
            }

            switch(status)
            {
            case Button_Status::kNone:
                /* Default state: press detected → trigger first press, enter pressed state */
                if(is_preesed())
                {
                    scan_cnt = 0;
                    click_cnt = 0;
                    trigger(Button_Event::kPressed_Down);
                    status = Button_Status::kPressed;
                }
                else
                {
                    event = Button_Event::kPressed_None;
                }
                break;

            case Button_Status::kPressed:
                if(is_preesed())
                {
                    /* Still pressed: determine long/short press first */
                    if(scan_cnt >= long_hold_trigger_ms)
                    {
                        /* Long hold reached: trigger only once */
                        if(event != Button_Event::kPressed_Long_Hold)
                            trigger(Button_Event::kPressed_Long_Hold);
                    }
                    else if(scan_cnt >= long_press_trigger_ms)
                    {
                        /* Long press start reached: trigger only once */
                        if(event != Button_Event::kPressed_Long_Start)
                            trigger(Button_Event::kPressed_Long_Start);
                    }
                    else if(scan_cnt >= short_press_trigger_ms)
                    {
                        /* Short press start reached: trigger only once */
                        if(event != Button_Event::kPressed_Short_Start)
                            trigger(Button_Event::kPressed_Short_Start);
                    }
                }
                else
                {
                    /* Released: accumulated time determines the trigger event */
                    if(scan_cnt >= long_hold_trigger_ms)
                    {
                        trigger(Button_Event::kPressed_Long_Hold_Over);
                        event = Button_Event::kPressed_None;
                        status = Button_Status::kNone;
                    }
                    else if(scan_cnt >= long_press_trigger_ms)
                    {
                        trigger(Button_Event::kPressed_Long_Over);
                        event = Button_Event::kPressed_None;
                        status = Button_Status::kNone;
                    }
                    else if(scan_cnt >= short_press_trigger_ms)
                    {
                        trigger(Button_Event::kPressed_Short_Over);
                        /* Short press released: enter multi-click judgment state, accumulate click count */
                        scan_cnt = 0;
                        click_cnt++;
                        status = Button_Status::kMultiple_Click;
                    }
                    else
                    {
                        /* Press too short: enter multi-click judgment state, accumulate click count */
                        scan_cnt = 0;
                        click_cnt++;
                        status = Button_Status::kMultiple_Click;
                    }
                }
                break;

            case Button_Status::kMultiple_Click:
                /* Multi-click judgment state */
                if(is_preesed())
                {
                    /* Pressed again: a new press edge. is_preesed() already debounces the
                     * falling edge, so this is reached on a real re-press only.
                     * kPressed_Down must be re-fired here, otherwise the app keeps the
                     * timestamp of the *previous* press and the press duration is wrong. */
                    scan_cnt = 0;
                    trigger(Button_Event::kPressed_Down);
                    status = Button_Status::kPressed;
                }
                else
                {
                    /* No press within multi-click interval: settle single/double/repeat click event */
                    if(scan_cnt > max_multiple_clicks_interval_ms)
                    {
                        trigger(click_cnt >= kRepeat_Click_Threshold
                                    ? Button_Event::kPressed_Repeat_Click :
                                click_cnt >= 2
                                    ? Button_Event::kDouble_Pressed_Click :
                                      Button_Event::kSignal_Pressed_Click);
                        click_cnt = 0;
                        event = Button_Event::kPressed_None; /* Clear event after settlement */
                        status = Button_Status::kNone;
                    }
                }
                break;

            default:
                break;
            }
            return true;
        }

/* ------------------------------------------------------------------------------------------------------------------------------------------------ */
/* ------------------------------------------------------------------------------------------------------------------------------------------------ */
        /**
         * @brief Traverse linked list, drive all button state machines
         * @return number of buttons in active state (non-default)
         */
        static uint8_t scan()
        {
            uint8_t active_cnt = 0;
            Button* current_node = s_head;

            while(current_node)
            {
                current_node->update();
                if(current_node->status != Button_Status::kNone)
                    active_cnt++;
                current_node = current_node->next;
            }
            return active_cnt;
        }

    private:
/* ------------------------------------------------------------------------------------------------------------------------------------------------ */
/* ------------------------------------------------------------------------------------------------------------------------------------------------ */
#ifdef BUTTON_FEATURE_ETL
        Button_Callback event_cb; // Callback object (delegate)
#else
        Button_Callback event_cb = nullptr; // Callback function pointer
        void*           user_data = nullptr; // User data pointer
#endif

        static Button* s_head; // Singly linked list head

        Button*         next                    = nullptr;                 // Linked list node pointer
        uint32_t        scan_cnt                = 0;                       // Scan counter (accumulated ms while pressed)
        uint16_t        click_cnt               = 0;                       // Click count (for single/double/repeat settlement)
        uint8_t         id                      = 0;                       // Button id (allocated by ctz at compile time)
        Button_Status   status                  = Button_Status::kNone;    // Current state machine state
        Button_Event    event                   = Button_Event::kPressed_None; // Current trigger event
        uint8_t         pressed_value           = kNot_Pressed;            // Whether currently pressed (0 = not / 1 = pressed)
        bool            debounce_primed         = false;                   // First scan after boot has no release edge: treated as stable-released (prevents phantom click)

/* ------------------------------------------------------------------------------------------------------------------------------------------------ */
/* ------------------------------------------------------------------------------------------------------------------------------------------------ */
        /**
         * @brief Set event and trigger callback
         * @param evt event to trigger
         */
        void trigger(Button_Event evt)
        {
            event = evt;
#ifdef BUTTON_FEATURE_ETL
            if(event_cb)
                event_cb(*this);
#else
            if(event_cb)
                event_cb(user_data, *this);
#endif
        }

        /**
         * @brief Append button to linked list (head insertion)
         * @param self button object
         */
        static void list_append(Button* self)
        {
            self->next = s_head;
            s_head = self;
        }

        /**
         * @brief Remove button from linked list
         * @param self button object
         */
        static void list_remove(Button* self)
        {
            Button** cur = &s_head;
            while (*cur)
            {
                if (*cur == self)
                {
                    *cur = self->next;
                    self->next = nullptr;
                    return;
                }
                cur = &(*cur)->next;
            }
        }

        /**
         * @brief Debounce judgment: both press/release levels must be stable for debounce_ms to confirm;
         *        debounce_ms==0 disables debounce
         * @return whether press is confirmed (unconfirmed release edge still treated as pressed until release stabilizes)
         */
        bool is_preesed()
        {
            uint32_t now = static_cast<uint32_t>(get_tick());

            if(pressed_value == kPressed)
            {
                release_debounce_start_tick = 0; /* Enter press, reset release debounce */
                debounce_primed = true;          /* Real press seen: later release edges must debounce normally */
                if(debounce_ms == 0)
                    return true; /* Debounce disabled: return directly */
                if(press_debounce_start_tick == 0)
                    press_debounce_start_tick = now; /* Record when this press started */
                return (now - press_debounce_start_tick) >= debounce_ms; /* Must persist debounce_ms to confirm */
            }
            else
            {
                press_debounce_start_tick = 0; /* Enter release, reset press debounce */
                if(debounce_ms == 0)
                    return false; /* Debounce disabled: return directly */

                if(!debounce_primed)
                {
                    /* make initial status is stable */
                    debounce_primed             = true;
                    release_debounce_start_tick = now ? now : 1u;
                    return false;
                }

                if(release_debounce_start_tick == 0)
                    release_debounce_start_tick = now; /* Record when this release started */
                return (now - release_debounce_start_tick) < debounce_ms; /* Release not yet stable for debounce_ms, still treated as pressed */
            }
        }
    } __attribute__((aligned(4)));

/* ------------------------------------------------------------------------------------------------------------------------------------------------ */
/* ------------------------------------------------------------------------------------------------------------------------------------------------ */
    // Button singly linked list head (defined outside class, shared by all buttons)
    inline Button* Button::s_head = nullptr;

    // Read the number of allocated buttons
    inline uint8_t read_num()
    {
        return static_cast<uint8_t>(__builtin_popcount(bit));
    }

    // Return system milliseconds
    inline int get_tick()
    {
        mini_os_tick_t tick;
        mini_os_get_tick(&tick);
        return (int)tick;
    }
}

#endif // BUTTON_HPP
